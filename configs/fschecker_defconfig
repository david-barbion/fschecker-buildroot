## configs/fschecker_defconfig
```kconfig
BR2_x86_64=y
BR2_x86_core2=y
BR2_TOOLCHAIN_BUILDROOT_GLIBC=y
BR2_KERNEL_HEADERS_4_9=y
BR2_GLIBC_VERSION_2_24=y
BR2_BINUTILS_VERSION_2_27_X=y
BR2_GCC_VERSION_6_X=y
BR2_TOOLCHAIN_BUILDROOT_CXX=y
BR2_TARGET_GENERIC_HOSTNAME="rescue"
BR2_TARGET_GENERIC_ISSUE="Welcome to Rescue system"
BR2_INIT_SYSV=y
BR2_TARGET_GENERIC_ROOT_PASSWD="rescue"
BR2_SYSTEM_BIN_SH_BASH=y
BR2_ROOTFS_OVERLAY="scripts/fschecker"
BR2_LINUX_KERNEL=y
BR2_LINUX_KERNEL_USE_CUSTOM_CONFIG=y
BR2_LINUX_KERNEL_CUSTOM_CONFIG_FILE="scripts/linux_defconfig"
BR2_PACKAGE_BTRFS_PROGS=y
BR2_PACKAGE_DOSFSTOOLS=y
BR2_PACKAGE_DOSFSTOOLS_FSCK_FAT=y
BR2_PACKAGE_F2FS_TOOLS=y
BR2_PACKAGE_NTFS_3G=y
BR2_PACKAGE_NTFS_3G_NTFSPROGS=y
BR2_PACKAGE_XFSPROGS=y
BR2_PACKAGE_DMIDECODE=y
BR2_PACKAGE_GPTFDISK=y
BR2_PACKAGE_HDPARM=y
BR2_PACKAGE_LVM2=y
BR2_PACKAGE_MDADM=y
BR2_PACKAGE_MEMTEST86=y
BR2_PACKAGE_NVME=y
BR2_PACKAGE_SDPARM=y
BR2_PACKAGE_SMARTMONTOOLS=y
BR2_PACKAGE_NCURSES_TARGET_PROGS=y
BR2_PACKAGE_DIALOG=y
BR2_PACKAGE_FILE=y
BR2_PACKAGE_TMUX=y
BR2_PACKAGE_COREUTILS=y
BR2_PACKAGE_HTOP=y
BR2_PACKAGE_UTIL_LINUX_BINARIES=y
BR2_PACKAGE_UTIL_LINUX_FSCK=y
BR2_PACKAGE_UTIL_LINUX_MOUNT=y
BR2_PACKAGE_UTIL_LINUX_PARTX=y
BR2_PACKAGE_NANO=y
BR2_TARGET_ROOTFS_CPIO=y
BR2_TARGET_ROOTFS_CPIO_GZIP=y
# BR2_TARGET_ROOTFS_TAR is not set
BR2_TARGET_SYSLINUX=y
BR2_TARGET_SYSLINUX_PXELINUX=y
```
